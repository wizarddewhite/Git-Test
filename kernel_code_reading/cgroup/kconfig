## kernel_code_reading/kbuild/test/Kconfig
```kconfig
menu "Test module Kconfig"
	depends on X86_32

config DOWN_DIR
	tristate "Test Down Directory"
	default n
	select DOWN_DIR_KCONFIG
	help
	  This is a test option

if DOWN_DIR
config BOOL_TYPE_TEST
	bool "Bool Type config entry"
	default n
	help
	  This is a bool type config entry

config STRING_TYPE_TEST
	string "String Type config entry"
	default "string in kconfig"

config DEFAULT_BOOL
	def_bool n
	prompt "Default bool type"

config INT_TYPE
	int "Int type (2-1024)"
	range 2 1024
	default 512 if X86_64
	default 128
endif

choice
	prompt "Choice entry test"
	default OPTION_TWO

config OPTION_ONE
	bool "option one"

config OPTION_TWO
	bool "option two"

endchoice

source "test/down_dir/Kconfig"
endmenu
```

## kernel_makefile/test/Kconfig
```kconfig
menu "Test module Kconfig"
	depends on X86_32

config DOWN_DIR
	tristate "Test Down Directory"
	default y
	select KEYS
	help
	  This is a test option

if DOWN_DIR
config BOOL_TYPE_TEST
	bool "Bool Type config entry"
	default n
	help
	  This is a bool type config entry

config STRING_TYPE_TEST
	string "String Type config entry"
	default "string in kconfig"

config DEFAULT_BOOL
	def_bool y
	prompt "Default bool type"

config INT_TYPE
	int "Int type (2-1024)"
	range 2 1024
	default 512 if X86_64
	default 128
endif

source "test/down_dir/Kconfig"
endmenu
```

## kernel_makefile/test/down_dir/Kconfig
```kconfig
menuconfig DOWN_DIR_KCONFIG
	bool "Enable down dir config"
	default n
	select MENUCONFIG_ENTRY

if DOWN_DIR_KCONFIG

config MENUCONFIG_ENTRY
	bool "Menuconfig entry"
	default n

endif # DOWN_DIR_KCONFIG
```
